## boards/arm/stm32f469i_disco/Kconfig.defconfig
```kconfig
# STM32F469I-DISCO board configuration

# Copyright (c) 2016 Linaro Limited.
# SPDX-License-Identifier: Apache-2.0

if BOARD_STM32F469I_DISCO

config BOARD
	default "stm32f469i_disco"

config SPI_STM32_INTERRUPT
	default y
	depends on SPI

if DISPLAY

config KSCAN
	default y

# MEMC needs to be enabled in order to store
# display buffer to external SDRAM connected to FMC
config MEMC
	default y

endif # DISPLAY

if KSCAN

#- https://github.com/STMicroelectronics/STM32CubeF7/blob/7e354cf248d84d84424e852ab012b345e3155640/Drivers/BSP/STM32746G-Discovery/stm32746g_discovery_ts.h#L161
#- https://github.com/STMicroelectronics/STM32CubeF7/blob/7e354cf248d84d84424e852ab012b345e3155640/Drivers/BSP/STM32746G-Discovery/stm32746g_discovery_ts.h#L169C2-L170
#+ https://github.com/STMicroelectronics/STM32CubeF4/blob/c031cf7d237abb4af772531a4b8fa0182b8d4427/Drivers/BSP/STM32469I-Discovery/stm32469i_discovery_ts.h#L169
#- ft5336.h https://github.com/STMicroelectronics/STM32CubeF7/blob/master/Drivers/BSP/Components/ft5336/ft5336.h
#+ ft6x06.h https://github.com/STMicroelectronics/STM32CubeF4/blob/master/Drivers/BSP/Components/ft6x06/ft6x06.h
# https://github.com/zephyrproject-rtos/zephyr/blob/712d682cf7f834f37f4a27ce078387cef17914d5/drivers/kscan/Kconfig.ft5336#L6
# bool "FT5XX6/FT6XX6 capacitive touch panel driver"
config KSCAN_FT5336_INTERRUPT
	default y
endif # KSCAN

config DISK_DRIVER_SDMMC
	default y if DISK_DRIVERS

endif # BOARD_STM32F469I_DISCO
```

## boards/arm/stm32f469i_disco/stm32f469i_disco_defconfig
```kconfig
# SPDX-License-Identifier: Apache-2.0

CONFIG_SOC_SERIES_STM32F4X=y
CONFIG_SOC_STM32F469XX=y

# Enable MPU
CONFIG_ARM_MPU=y

# Enable HW stack protection
CONFIG_HW_STACK_PROTECTION=y

CONFIG_SERIAL=y

# console
CONFIG_CONSOLE=y
CONFIG_UART_CONSOLE=y

# enable GPIO
CONFIG_GPIO=y

# Enable Clocks
CONFIG_CLOCK_CONTROL=y

# enable pin controller
CONFIG_PINCTRL=y

CONFIG_MEMC=y
CONFIG_STM32_LTDC_RGB888=y
CONFIG_HEAP_MEM_POOL_SIZE=65536
# Initialize after LTDC
CONFIG_DISPLAY_OTM8009A_INIT_PRIORITY=86
```

## dts/bindings/clock/st,stm32f4-pll-clock.yaml
```yaml
# Copyright (c) 2021, Linaro ltd
# SPDX-License-Identifier: Apache-2.0

description: |
  STM32L4 Main PLL node binding:

  Takes one of clk_hse or clk_hsi as input clock, with an
  input frequency from 1 to 2 MHz. PLLM factor is used to set the input clock
  in this acceptable range.

  Up to 2 output clocks could be supported and for each output clock, the
  frequency can be computed with the following formula:

    f(PLL_P) = f(VCO clock) / PLLP  --> PLLCLK (System Clock)
    f(PLL_Q) = f(VCO clock) / PLLQ  --> PLL48CLK (Optional)

      with f(VCO clock) = f(PLL clock input) × (PLLN / PLLM)

  The PLL output frequency must not exceed 80 MHz.


compatible: "st,stm32f4-pll-clock"

include: [clock-controller.yaml, base.yaml]

properties:
  "#clock-cells":
    const: 0

  clocks:
    required: true

  div-m:
    type: int
    required: true
    description: |
        Division factor for PLLx
        input clock
        Valid range: 1 - 63

  mul-n:
    type: int
    required: true
    description: |
        Main PLL multiplication factor for VCOx
        Valid range: 4 - 512

  div-p:
    type: int
    description: |
        PLL division factor for pllx_p_ck
        Valid range: 1 - 128

  div-q:
    type: int
    description: |
        PLL division factor for pllx_q_ck
        Valid range: 1 - 128

  div-r:
    type: int
    description: |
        PLL division factor for pllx_r_ck
        Valid range: 1 - 128

  r-divr:
    type: int
    description: |
        Second stage division factor for pllx_r_ck output
        Valid values: 2, 4, 8, 16
```
